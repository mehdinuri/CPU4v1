/* ///////////////////////////////////////////////////////////////////////////////////////////////// */
/*  include files */
#include "main.h"

#include "lcdDrv.h"

#include <stdio.h>
#include <stdlib.h>
#include <string.h>

#include "iwdg.h"
/* ///////////////////////////////////////////////////////////////////////////////////////////////// */
/*  constants */
const char baaASCIIChars[256][LCD_CHAR_WIDTH] = { { 0x00, 0x00, 0x00, 0x00,
                                                    0x00, 0x00 },                         /* 0 */
                                                  { 0x00, 0x00, 0x00, 0x00,
                                                    0x00, 0x00 },                         /* 1 */
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                                                  { 0x00, 0x00, 0x00, 0x00,
                                                    0x00, 0x00 },                         /* ff */
};

/* ///////////////////////////////////////////////////////////////////////////////////////////////// */
/*  members */

/* ///////////////////////////////////////////////////////////////////////////////////////////////// */
/*  methods */
void ResetLCD(void)
{
  /* set motorola 6800 family interface */
  LCDResetLow();
  TurnOffLCD();
  DWTDelayuSeconds(1000);
  LCDResetHigh();
  TurnOnLCD();
  DWTDelayuSeconds(1000);
  LCDResetLow();
  DWTDelayuSeconds(1000);
  LCDResetHigh();
}

void WriteLCDCommand(uint8_t bControllerNo, uint8_t bCommand, uint8_t bParam)
{
  AddressLCDControl();
  if (bControllerNo == LCD_CONTROLLER0)
  {
    SetLCDE1();
    WriteLCDDataBus(bCommand | bParam);
    ClearLCDE1();
  }
  else
  {
    SetLCDE2();
    WriteLCDDataBus(bCommand | bParam);
    ClearLCDE2();
  }
}

void WriteLCDData(uint8_t bPage,
                  uint8_t bCol,
                  uint8_t bLength,
                  uint8_t *pbWriteBuffer)
{
  uint8_t bController;
  uint8_t bColNo = bCol;
  uint8_t *pbLCDData = pbWriteBuffer;

  /* check parameters */
  if (bPage > LCD_LAST_PAGE_NO)
  {
    return;
  }

  if (bCol > LCD_LAST_COLUMN_NO)
  {
    return;
  }

  if ((bLength + bCol) > LCD_DISPLAY_WIDTH)
  {
    return;
  }

  /* Address page */
  WriteLCDCommand(LCD_CONTROLLER0, LCD_SET_PAGE_ADDRESS, bPage);
  WriteLCDCommand(LCD_CONTROLLER1, LCD_SET_PAGE_ADDRESS, bPage);

  /* Address starting column */
  if (bCol < LCD_CONTROLLER1_START_COLUMN)
  {
    bController = LCD_CONTROLLER0;
    WriteLCDCommand(bController, LCD_SET_COLUMN_ADDRESS, bCol);
  }
  else
  {
    bController = LCD_CONTROLLER1;
    WriteLCDCommand(bController, LCD_SET_COLUMN_ADDRESS,
                    (uint8_t) (bCol - LCD_CONTROLLER1_START_COLUMN));
  }

  /* start write */
  AddressLCDData();
  while (bColNo < (bCol + bLength))
  {
    if (bController == LCD_CONTROLLER0)
    {
      SetLCDE1();
      WriteLCDDataBus(*pbLCDData);
      ClearLCDE1();
    }
    else
    {
      SetLCDE2();
      WriteLCDDataBus(*pbLCDData);
      ClearLCDE2();
    }

    pbLCDData++;
    bColNo++;

    /* bColNo is increasing and it may equal 61 that is controlled by */
    /* LCD_CONTROLLER1 */
    if (bController == LCD_CONTROLLER0)
    {
      if (bColNo > LCD_CONTROLLER0_LAST_COLUMN)
      {
        bController = LCD_CONTROLLER1;
        WriteLCDCommand(bController, LCD_SET_COLUMN_ADDRESS, 0); /* addresing is in function */
        AddressLCDData();
      }
    }
  }
} /* WriteLCDData */

void ClearLine(uint8_t bLineNo)
{
  uint8_t bClearChar = 0;
  uint8_t bColumns;

  for (bColumns = 0; bColumns < LCD_LAST_COLUMN_NO + 1; bColumns++)
  {
    WriteLCDData(bLineNo, bColumns, 1, &bClearChar);
  }
}

void LCDWriteChar(uint8_t bLine, uint8_t *pbColumn, char bChar)
{
  uint8_t bCnt;
  uint8_t strStringBuffer[LCD_CHAR_WIDTH];
  uint8_t bCharIndex = bChar;

  /* since cursor will be a bar on the left, leave leftmost column blank */
  strStringBuffer[0] = 0;

  for (bCnt = 1; bCnt < LCD_CHAR_WIDTH; bCnt++)
  {
    strStringBuffer[bCnt] = baaASCIIChars[bCharIndex][bCnt - 1];
  }

  WriteLCDData(bLine, *pbColumn, LCD_CHAR_WIDTH, strStringBuffer);

  *pbColumn +=
    LCD_CHAR_WIDTH;   /* advance to the next blank space for the next character */
}

void InitLCD(void)
{
  /* both controllers must have the same settings */
  WriteLCDCommand(LCD_CONTROLLER0, LCD_DUTY_32, 0);
  WriteLCDCommand(LCD_CONTROLLER1, LCD_DUTY_32, 0);
  WriteLCDCommand(LCD_CONTROLLER0, LCD_SELECT_ADC_CW, 0);
  WriteLCDCommand(LCD_CONTROLLER1, LCD_SELECT_ADC_CW, 0);
  WriteLCDCommand(LCD_CONTROLLER0, LCD_SET_START_LINE, 0);
  WriteLCDCommand(LCD_CONTROLLER1, LCD_SET_START_LINE, 0);
  WriteLCDCommand(LCD_CONTROLLER0, LCD_DISPLAY_ON, 0);
  WriteLCDCommand(LCD_CONTROLLER1, LCD_DISPLAY_ON, 0);
}

void OpenLCD(void)
{
  ResetLCD();     /* also opens lcd */
  DWTDelayuSeconds(1000);
  InitLCD();
}

void LCDClose(void)
{
  WriteLCDDataBus(0);
  LCDResetLow();
  TurnOffLCD();
}

void HardwareSetupLCD(void)
{
  /* SetLCDBusPinModes(); // data ports are output */
  WriteLCDDataBus(0);

  TurnOffLCD();
  /* LCDPowerPinInit(); */
  LCDResetHigh();
  /* LCDResetPinInit(); */
  AddressLCDControl();
  /* LCDA0PinInit(); */
  ClearLCDE1();
  /* LCDE1PinInit(); */
  ClearLCDE2();
  /* LCDE2PinInit(); */
  LCDWriteMode();
  /* LCDWrPinInit(); */

  ResetLCD(); /* also opens LCD using TurnOnLCD() */
  DWTDelayuSeconds(1000);
  InitLCD();

  ClearLine(0);
  ClearLine(1);
  ClearLine(2);
  ClearLine(3);

  /* GPIOKeypadInit(); */
}
